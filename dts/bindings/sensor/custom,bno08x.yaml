## dts/bindings/sensor/custom,bno08x.yaml
```yaml
# Copyright (c) 2024 Your Name
# SPDX-License-Identifier: Apache-2.0

description: Hillcrest/CEVA BNO086 9-axis IMU sensor

compatible: "custom,bno08x"

include: [sensor-device.yaml, i2c-device.yaml]

properties:
  int-gpios:
    type: phandle-array
    description: |
      The INT pin defaults to active high when produced by the sensor.
      The property value should ensure the flags properly describe
      the signal that is presented to the driver.

  reset-gpios:
    type: phandle-array
    description: |
      The RST pin of BNO086. This signal is active low.
```
