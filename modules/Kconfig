## modules/Kconfig
```kconfig
# SPDX-License-Identifier: Apache-2.0

# Module-level configuration
menuconfig CUSTOM_SENSORS
    bool "Enable Custom Sensor Drivers"
    help
      Enable custom sensor drivers module

if CUSTOM_SENSORS
    rsource "sensor/bno08x/Kconfig"
    rsource "sensor/vl53l0x/Kconfig"
endif
```

## modules/dts/bindings/sensor/bno086.yaml
```yaml
# Copyright (c) 2024 Your Name
# SPDX-License-Identifier: Apache-2.0

description: Hillcrest/CEVA BNO086 9-axis IMU sensor

compatible: "ceva,bno086"

include: [sensor-device.yaml, i2c-device.yaml]

properties:
  irq-gpios:
    type: phandle-array
    description: |
      The INT pin defaults to active high when produced by the sensor.
      The property value should ensure the flags properly describe
      the signal that is presented to the driver.

  reset-gpios:
    type: phandle-array
    description: |
      The RST pin of BNO086. This signal is active low.
```

## modules/dts/bindings/sensor/custom,vl53l0x.yaml
```yaml
description: VL53 Time-of-Flight sensor

compatible: "custom,vl53l0x"

include: [sensor-device.yaml, i2c-device.yaml]
```

## modules/sensor/bno08x/Kconfig
```kconfig
# SPDX-License-Identifier: Apache-2.0

menuconfig CUSTOM_BNO08X
	bool "CUSTOM_BNO08X IMU sensor driver"
	default y
	depends on DT_HAS_CUSTOM_BNO08X_ENABLED
	select I2C
	help
	  Enable driver for Hillcrest CUSTOM_BNO08X IMU sensor with sensor fusion.


config CUSTOM_BNO08X_LOG_LEVEL
	int "CUSTOM_BNO08X Log level"
	depends on LOG
	depends on CUSTOM_BNO08x
	default 3
	range 0 4
	help
	  Sets log level for CUSTOM_BNO08X driver.
	  0 = OFF, 1 = ERROR, 2 = WARNING, 3 = INFO, 4 = DEBUG

config CUSTOM_BNO08X_TRIGGER
	bool "CUSTOM_BNO08X interrupt support"
	depends on GPIO
	depends on BNO08x
	help
	  Enable interrupt support for CUSTOM_BNO08X sensor.
```

## modules/sensor/vl53l0x/Kconfig
```kconfig
# SPDX-License-Identifier: Apache-2.0

# In your Kconfig
menuconfig CUSTOM_VL53L0X
    bool "CUSTOM_VL53L0X sensor driver"
    default y
    depends on DT_HAS_CUSTOM_VL53L0X_ENABLED #compatible = "custom,vl53l0x"
    help
      Enable driver for CUSTOM_VL53L0X sensor

# Add a debug option
config CUSTOM_VL53L0X_DEBUG
    bool "Debug CUSTOM_VL53L0X configuration"
    default n
    help
      Debug message for CUSTOM_VL53L0X config
```
